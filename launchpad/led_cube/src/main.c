#include <stdio.h>

#include "inc/lm4f120h5qr.h"

#include "inc/hw_types.h"
#include "inc/hw_memmap.h"

#include "driverlib/sysctl.h"
#include "driverlib/systick.h"
#include "driverlib/watchdog.h"

#include "jaguar.h"
#include "cpu_interface.h"
#include "pwm.h"

#define WAIT_1MS ((SysCtlClockGet()/3)/1000)
#define WAIT_1US ((SysCtlClockGet()/3)/1000/1000)
#define delay_ms(x) SysCtlDelay( (x) * WAIT_1MS );

#define LED_RED 0x2
#define LED_BLUE 0x4
#define LED_GREEN 0x8

/* Slice 0 [top] - PE5
 *       1       - PB4
 *       2       - PA5
 *       3       - PA6
 *       4       - PA7
 *       5       - PD3
 *       6       - PE1
 *       7 [bot] - PE2
 *
 * Clock         - PB0
 * Data          - PB1
 */

void setSlice(uint8_t slice)
{
	// Shut off all slices.
	GPIO_PORTA_DATA_R &= ~0b11100000;
	GPIO_PORTB_DATA_R &= ~0b00010011;
	GPIO_PORTD_DATA_R &= ~0b00001000;
	GPIO_PORTE_DATA_R &= ~0b00100110;
	switch (slice)
	{
		case 0:
			GPIO_PORTE_DATA_R |= (1<<5);
			break;
		case 1:
			GPIO_PORTB_DATA_R |= (1<<4);
			break;
		case 2:
			GPIO_PORTA_DATA_R |= (1<<5);
			break;
		case 3:
			GPIO_PORTA_DATA_R |= (1<<6);
			break;
		case 4:
			GPIO_PORTA_DATA_R |= (1<<7);
			break;
		case 5:
			GPIO_PORTD_DATA_R |= (1<<3);
			break;
		case 6:
			GPIO_PORTE_DATA_R |= (1<<1);
			break;
		case 7:
			GPIO_PORTE_DATA_R |= (1<<2);
			break;
		default:
			break;
	}
}

#define DEL 1

void drawSlice(const uint8_t rows[])
{
	uint8_t i,j;
	for(i = 0; i < 8; i++)
	{
		for(j = 0; j < 8; j++)
		{
			if(!(rows[i] & (1<<j))) GPIO_PORTB_DATA_R |= 0x02; // Flip the bit!
			else GPIO_PORTB_DATA_R &= ~(0x02); // Flip the bit!

			GPIO_PORTB_DATA_R &= ~(0x01); // Bring line low again.
			GPIO_PORTB_DATA_R |= 0x01; // Bring line high.
			
		}
	}
}

void drawFrame(const uint8_t frame[8][8])
{
	uint8_t i;
	for(i = 0; i < 8; i++)
	{
		setSlice(i);
		drawSlice(frame[i]);
		SysCtlDelay( 1000 * WAIT_1US );
	}
}

const uint8_t frames[8][8][8] = {
	{

		{0xff,0xff,0xff,0xff,0xff,0xff,0xff,0xff},
		{0x0,0x0,0x0,0x0,0x0,0x0,0x0,0x0},
		{0x0,0x0,0x0,0x0,0x0,0x0,0x0,0x0},
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		{0xff,0xff,0xff,0xff,0xff,0xff,0xff,0xff}
	},
	{

		{0xff,0xff,0xff,0xff,0xff,0xff,0xff,0xff},
		{0x0,0x7e,0x7e,0x7e,0x7e,0x7e,0x7e,0x0},
		{0x0,0x0,0x0,0x0,0x0,0x0,0x0,0x0},
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		{0xff,0xff,0xff,0xff,0xff,0xff,0xff,0xff}
	},
	{

		{0xff,0xff,0xff,0xff,0xff,0xff,0xff,0xff},
		{0x0,0x7e,0x7e,0x7e,0x7e,0x7e,0x7e,0x0},
		{0x0,0x0,0x3c,0x3c,0x3c,0x3c,0x0,0x0},
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		{0xff,0xff,0xff,0xff,0xff,0xff,0xff,0xff}
	},
	{

		{0xff,0xff,0xff,0xff,0xff,0xff,0xff,0xff},
		{0x0,0x7e,0x7e,0x7e,0x7e,0x7e,0x7e,0x0},
		{0x0,0x0,0x3c,0x3c,0x3c,0x3c,0x0,0x0},
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		{0xff,0xff,0xff,0xff,0xff,0xff,0xff,0xff}
	},
	{

		{0x0,0x0,0x0,0x0,0x0,0x0,0x0,0x0},
		{0x0,0x0,0x0,0x0,0x0,0x0,0x0,0x0},
		{0x0,0x0,0x0,0x0,0x0,0x0,0x0,0x0},
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		{0x0,0x0,0x0,0x0,0x0,0x0,0x0,0x0}
	},
	{

		{0x0,0x0,0x0,0x0,0x0,0x0,0x0,0x0},
		{0x0,0x0,0x0,0x0,0x0,0x0,0x0,0x0},
		{0x0,0x0,0x3c,0x3c,0x3c,0x3c,0x0,0x0},
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		{0x0,0x0,0x0,0x0,0x0,0x0,0x0,0x0}
	},
	{

		{0x0,0x0,0x0,0x0,0x0,0x0,0x0,0x0},
		{0x0,0x7e,0x7e,0x7e,0x7e,0x7e,0x7e,0x0},
		{0x0,0x0,0x0,0x0,0x0,0x0,0x0,0x0},
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		{0x0,0x0,0x0,0x0,0x0,0x0,0x0,0x0}
	},
	{

		{0xff,0xff,0xff,0xff,0xff,0xff,0xff,0xff},
		{0x0,0x0,0x0,0x0,0x0,0x0,0x0,0x0},
		{0x0,0x0,0x0,0x0,0x0,0x0,0x0,0x0},
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		{0xff,0xff,0xff,0xff,0xff,0xff,0xff,0xff}
	}

};

volatile uint8_t clear_watchdog = 0;

void watchdog_int(void)
{
	if( clear_watchdog ) 
	{
		WatchdogIntClear( WATCHDOG0_BASE );
	}
	else
	{
		GPIO_PORTF_DATA_R |= LED_GREEN|LED_BLUE|LED_RED;
	}
	clear_watchdog = 0;
}

int main(void)
{
	// enable GPIO peripheral
	SysCtlPeripheralEnable(SYSCTL_PERIPH_GPIOA);
	SysCtlPeripheralEnable(SYSCTL_PERIPH_GPIOB);
	SysCtlPeripheralEnable(SYSCTL_PERIPH_GPIOD);
	SysCtlPeripheralEnable(SYSCTL_PERIPH_GPIOE);
	SysCtlPeripheralEnable(SYSCTL_PERIPH_GPIOF);
	SysCtlPeripheralEnable(SYSCTL_PERIPH_WDOG0);

	// set pins as outputs
	GPIO_PORTA_DIR_R = 0b11100000;
	GPIO_PORTB_DIR_R = 0b00010011;
	GPIO_PORTD_DIR_R = 0b00001000;
	GPIO_PORTE_DIR_R = 0b00100110;
	GPIO_PORTF_DIR_R = LED_RED|LED_BLUE|LED_GREEN;

	// enable digital outputs
	GPIO_PORTA_DEN_R = 0b11100000;
	GPIO_PORTB_DEN_R = 0b00010011;
	GPIO_PORTD_DEN_R = 0b00001000;
	GPIO_PORTE_DEN_R = 0b00100110;
	GPIO_PORTF_DEN_R = LED_RED|LED_BLUE|LED_GREEN;

	// clear all PORT F pins
	GPIO_PORTF_DATA_R = 0;

	SysCtlDelay( 1000 * WAIT_1MS );

	// Init lines go here...

	SysCtlDelay( 10 * WAIT_1MS );

	//	cpu_message_init();


	/*
	// sys tick setup - overflow every 2 seconds
	SysTickPeriodSet( 2 * SysCtlClockGet() );
	SysTickEnable();

	// Watchdog setup
	WatchdogReloadSet( WATCHDOG0_BASE, SysCtlClockGet() / 2 );
	WatchdogResetEnable( WATCHDOG0_BASE );
	WatchdogIntEnable( WATCHDOG0_BASE );
	WatchdogIntRegister( WATCHDOG0_BASE, watchdog_int );

	// Lock and start it
	WatchdogEnable( WATCHDOG0_BASE );
	WatchdogLock( WATCHDOG0_BASE );
	 */

	SysCtlDelay( 10 * WAIT_1MS );

	//jaguar_control_mode_set( SPEED_CONTROL, RIGHT_MOTOR, 20<<16 );
	//jaguar_control_mode_set( SPEED_CONTROL, LEFT_MOTOR, 20<<16 );

	//pwm_init();

	// loop forever
	setSlice(0);
	volatile uint8_t fCnt = 0;
	for(;;)
	{
		//GPIO_PORTF_DATA_R |= LED_GREEN|LED_BLUE|LED_RED;
		uint32_t i;
		//uint8_t values1[8] = {0x01,0x02,0x04,0x08,0x10,0x20,0x40,0x80};
		//uint8_t values2[8] = {0x80,0x40,0x20,0x10,0x08,0x04,0x02,0x01};
		for(i=0; i<((1<<4)-1); i++)
		{
			drawFrame(frames[fCnt]);		
		}
		fCnt++;
		if(fCnt > 7) fCnt = 0;
	}
}
